## boards/shields/shin_uchi42_air/Kconfig.defconfig
```kconfig
if SHIN_UCHI42_AIR_LEFT

config ZMK_KEYBOARD_NAME
    default "Shin-Uchi42 Air"

config ZMK_SPLIT_ROLE_CENTRAL
    default y

endif

if SHIN_UCHI42_AIR_LEFT || SHIN_UCHI42_AIR_RIGHT

config ZMK_SPLIT
    default y

endif
```

## boards/shields/shin_uchi42_air/Kconfig.shield
```kconfig
config SHIN_UCHI42_AIR_LEFT
    def_bool $(shields_list_contains,shin_uchi42_air_left)

config SHIN_UCHI42_AIR_RIGHT
    def_bool $(shields_list_contains,shin_uchi42_air_right)
```
